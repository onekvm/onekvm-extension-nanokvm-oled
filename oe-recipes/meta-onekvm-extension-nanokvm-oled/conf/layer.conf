## oe-recipes/meta-onekvm-extension-nanokvm-oled/conf/layer.conf
```bitbake
BBPATH .= ":${LAYERDIR}"
BBFILES += "${LAYERDIR}/recipes-*/*/*.bb ${LAYERDIR}/recipes-*/*/*.bbappend"
BBFILE_COLLECTIONS += "onekvm-extension-nanokvm-oled"
BBFILE_PATTERN_onekvm-extension-nanokvm-oled := "^${LAYERDIR}/"
BBFILE_PRIORITY_onekvm-extension-nanokvm-oled = "8"
LAYERDEPENDS_onekvm-extension-nanokvm-oled = "core onekvm"
LAYERSERIES_COMPAT_onekvm-extension-nanokvm-oled = "wrynose"
```
